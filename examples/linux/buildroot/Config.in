## examples/linux/buildroot/configs/openavc_aarch64_defconfig
```kconfig
BR2_aarch64=y
BR2_TOOLCHAIN_EXTERNAL=y
BR2_TOOLCHAIN_EXTERNAL_BOOTLIN=y
BR2_TOOLCHAIN_EXTERNAL_BOOTLIN_AARCH64_GLIBC_STABLE=y
BR2_PACKAGE_OPENAVC_SDK=y
BR2_PACKAGE_OPENAVC_SDK_EXAMPLES=y
BR2_PACKAGE_PYTHON3=y
BR2_PACKAGE_PYTHON3_SSL=y
BR2_PACKAGE_LIBOPENSSL_BIN=y
BR2_TARGET_ROOTFS_TAR=y
# BR2_TARGET_GENERIC_GETTY is not set
# BR2_TARGET_GENERIC_REMOUNT_ROOTFS_RW is not set
# BR2_PACKAGE_IFUPDOWN_SCRIPTS is not set
```

## examples/linux/buildroot/package/openavc-sdk/Config.in
```kconfig
config BR2_PACKAGE_OPENAVC_SDK
	bool "openavc-sdk"
	depends on BR2_aarch64 || BR2_x86_64
	depends on BR2_INSTALL_LIBSTDCPP
	depends on BR2_TOOLCHAIN_HAS_THREADS
	depends on !BR2_STATIC_LIBS
	depends on BR2_TOOLCHAIN_GCC_AT_LEAST_8
	select BR2_PACKAGE_OPENSSL
	select BR2_PACKAGE_OPENSSL_FORCE_LIBOPENSSL
	help
	  Native OpenAVC device service and hardware adapter libraries.
	  Uses the SDK checkout containing this external tree. Python
	  is needed on the build host for generation, not on the target
	  for these native components. Product management and the optional
	  full OpenAVC server are separate Python components.

if BR2_PACKAGE_OPENAVC_SDK

config BR2_PACKAGE_OPENAVC_SDK_PRODUCT
	string "product description (absolute path, empty for example)"
	default ""
	help
	  Select your product.json before building the generated adapter.
	  Keep this file in your product source. An empty path uses the
	  supplied amplifier model. No sample hardware application or
	  service startup configuration is installed by this package.

config BR2_PACKAGE_OPENAVC_SDK_EXAMPLES
	bool "install invented amplifier examples"
	depends on BR2_PACKAGE_OPENAVC_SDK_PRODUCT = ""
	help
	  Build and install the supplied C and C++ sample hardware
	  applications for evaluation. They are not started automatically.

endif

comment "openavc-sdk needs ARM64/x86-64, C++, threads, dynamic libraries and GCC >= 8"
	depends on BR2_aarch64 || BR2_x86_64
	depends on !BR2_INSTALL_LIBSTDCPP || !BR2_TOOLCHAIN_HAS_THREADS || BR2_STATIC_LIBS || !BR2_TOOLCHAIN_GCC_AT_LEAST_8
```

## examples/linux/yocto/meta-openavc/conf/layer.conf
```bitbake
BBPATH .= ":${LAYERDIR}"
BBFILES += "${LAYERDIR}/recipes-openavc/*/*.bb"
BBFILE_COLLECTIONS += "openavc"
BBFILE_PATTERN_openavc = "^${LAYERDIR}/"
BBFILE_PRIORITY_openavc = "6"
LAYERSERIES_COMPAT_openavc = "wrynose"
LAYERDEPENDS_openavc = "core openembedded-layer meta-python"
```
